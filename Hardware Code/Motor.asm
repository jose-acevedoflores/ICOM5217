;------------------------------------------------------------------------------
#include "msp430.h"                     ; #define controlled include file            
;------------------------------------------------------------------------------
            ORG  05400h                 ; Program Start           
;------------------------------------------------------------------------------
RESET      mov.w  #04400h,SP                 ; Initialize Stackpointer
STOPWDT    MOV.W  #WDTPW+WDTHOLD,&WDTCTL     ; Stop Watchdog Timer
        
           BIS.b  #011000000b, P4DIR
           BIS.b  #01000000b, &P4OUT
           mov.w #4000, R6
L1         CALL  #STEP  
           DEC R6
           JNZ L1
            
           xor.b #01000000b, &P4OUT      
           mov.w #4000, R6
L3         CALL  #STEP  
           DEC R6
           JNZ L3           

Finish     jmp $
;------------------------------------------------------------------------------
;               Step Subroutine
;------------------------------------------------------------------------------
STEP       BIS.b #080h, &P4OUT               ;
           CALL #WAITS
           
           BIC.b #010000000b, &P4OUT             ;
           CALL #WAITS
           
           ret
;------------------------------------------------------------------------------
;               Wait Subroutine
;------------------------------------------------------------------------------ 
WAITS     mov.w #500, R5
L2        DEC R5
          jnz L2     
          ret;
;------------------------------------------------------------------------------
;               Interrupt Vectors
;------------------------------------------------------------------------------
            ORG  0FFFEh                 ; MSP430F5438 Reset Vector
            DW   RESET                  ;
            
            END                         ;